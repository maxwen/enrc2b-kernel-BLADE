## drivers/cpuquiet/Kconfig
```kconfig
menu "CPUQUIET Framework"

config CPUQUIET_FRAMEWORK
	bool "Cpuquiet framework"
	help
	  Cpuquiet implements pluggable policies for forcing cpu cores into a
	  quiescent state. Appropriate policies will save power without hurting
	  performance.

endmenu
```
